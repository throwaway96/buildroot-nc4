## package/webos-gnutls/Config.in
```kconfig
config BR2_PACKAGE_WEBOS_GNUTLS
	bool "old gnutls"
	depends on BR2_WEBOS_COMPAT
	depends on BR2_PACKAGE_GNUTLS
	help
	  Old version of gnutls for webOS.
```

## package/webos/Config.in
```kconfig
config BR2_PACKAGE_WEBOS
	bool "webos"
	depends on BR2_INSTALL_LIBSTDCPP
	depends on BR2_TOOLCHAIN_HAS_THREADS
	depends on BR2_PACKAGE_LGTV
	help
	  WebOS meta-package

config BR2_WEBOS_COMPAT
	bool "webOS compat"
	depends on BR2_PACKAGE_WEBOS
	select BR2_PACKAGE_WEBOS_GMP if BR2_PACKAGE_GMP
	select BR2_PACKAGE_WEBOS_GNUTLS if BR2_PACKAGE_GNUTLS
```
